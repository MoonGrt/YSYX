## memu/csrc/device/Kconfig
```kconfig
menuconfig DEVICE
  depends on !TARGET_SHARE
  bool "Devices"
  default y
  help
    Provide host-side device models. In NEMU SoC mode these models implement
    the same address map and register interfaces as the RTL SoC.

if DEVICE && SOC

config NVBOARD
  depends on NPC
  bool "Enable NVBoard"
  default n
  help
    Bind the SoC GPIO, PS/2, VGA and UART pins to NVBoard.

config NVBOARD_VGA_CAPTURE
  depends on NVBOARD && HAS_VGA
  bool "Capture VGA output in NVBoard"
  default y
  help
    Disable this while testing software that only needs the NVBoard keyboard,
    UART, GPIO or seven-segment display. Skipping per-pixel VGA sampling can
    substantially improve simulation speed.

menuconfig HAS_SERIAL
  bool "Enable UART16550"
  default y

if HAS_SERIAL
config SOC_UART_MMIO
  hex "UART MMIO address"
  default 0x10000000

config SOC_UART_SIZE
  hex "UART MMIO size"
  default 0x1000

config SOC_UART_INPUT
  bool "Enable terminal input"
  default y
endif

menuconfig HAS_SPI
  bool "Enable SPI controller"
  default y

if HAS_SPI
config SOC_SPI_MMIO
  hex "SPI controller MMIO address"
  default 0x10001000

config SOC_SPI_SIZE
  hex "SPI controller MMIO size"
  default 0x1000

config SOC_SPI_FLASH
  bool "Enable SPI flash slave"
  default y

config SOC_SPI_BITREV
  bool "Enable bit-reversal slave"
  default y
endif

menuconfig HAS_GPIO
  bool "Enable GPIO"
  default y

if HAS_GPIO
config SOC_GPIO_MMIO
  hex "GPIO MMIO address"
  default 0x10002000

config SOC_GPIO_SIZE
  hex "GPIO MMIO size"
  default 0x10

config SOC_GPIO_INPUT
  hex "Initial GPIO switch value"
  range 0x0 0xffff
  default 0x0
endif

menuconfig HAS_KEYBOARD
  bool "Enable PS/2 keyboard"
  default y

if HAS_KEYBOARD
config SOC_PS2_MMIO
  hex "PS/2 MMIO address"
  default 0x10011000

config SOC_PS2_SIZE
  hex "PS/2 MMIO size"
  default 0x8
endif

menuconfig HAS_VGA
  bool "Enable VGA framebuffer"
  default y

if HAS_VGA
config SOC_VGA_ADDR
  hex "VGA framebuffer address"
  default 0x21000000

config SOC_VGA_SIZE
  hex "VGA framebuffer mapping size"
  default 0x200000

endif

endif

if DEVICE && !SOC

config HAS_PORT_IO
  bool
  default y if ISA_x86
  default n

menuconfig HAS_SERIAL
  bool "Enable serial"
  default y

if HAS_SERIAL
config SERIAL_PORT
  depends on HAS_PORT_IO
  hex "Port address of the serial controller"
  default 0x3f8

config SERIAL_MMIO
  hex "MMIO address of the serial controller"
  default 0xa00003f8

config SERIAL_INPUT_FIFO
  bool "Enable input FIFO with /tmp/memu.serial"
  default n
endif # HAS_SERIAL

menuconfig HAS_TIMER
  bool "Enable timer"
  default y

if HAS_TIMER
config RTC_PORT
  depends on HAS_PORT_IO
  hex "Port address of the timer"
  default 0x48

config RTC_MMIO
  hex "MMIO address of the timer"
  default 0xa0000048
endif # HAS_TIMER

menuconfig HAS_KEYBOARD
  bool "Enable keyboard"
  default y

if HAS_KEYBOARD
config I8042_DATA_PORT
  depends on HAS_PORT_IO
  hex "Port address of the keyboard controller"
  default 0x60

config I8042_DATA_MMIO
  hex "MMIO address of the keyboard controller"
  default 0xa0000060
endif # HAS_KEYBOARD

menuconfig HAS_VGA
  bool "Enable VGA"
  default y

if HAS_VGA
config FB_ADDR
  hex "Physical address of the VGA frame buffer"
  default 0xa1000000

config VGA_CTL_PORT
  depends on HAS_PORT_IO
  hex "Port address of the VGA controller"
  default 0x100

config VGA_CTL_MMIO
  hex "MMIO address of the VGA controller"
  default 0xa0000100

config VGA_SHOW_SCREEN
  bool "Enable SDL SCREEN"
  default y

choice
  prompt "Screen Size"
  default VGA_SIZE_400x300
config VGA_SIZE_400x300
  bool "400 x 300"
config VGA_SIZE_800x600
  bool "800 x 600"
endchoice
endif # HAS_VGA

if !TARGET_AM
menuconfig HAS_AUDIO
  bool "Enable audio"
  default y

if HAS_AUDIO
config SB_ADDR
  hex "Physical address of the audio stream buffer"
  default 0xa1200000

config SB_SIZE
  hex "Size of the audio stream buffer"
  default 0x10000

config AUDIO_CTL_PORT
  depends on HAS_PORT_IO
  hex "Port address of the audio controller"
  default 0x200

config AUDIO_CTL_MMIO
  hex "MMIO address of the audio controller"
  default 0xa0000200
endif # HAS_AUDIO

menuconfig HAS_DISK
  bool "Enable disk"
  default y

if HAS_DISK
config DISK_CTL_PORT
  depends on HAS_PORT_IO
  hex "Port address of the disk controller"
  default 0x300

config DISK_CTL_MMIO
  hex "MMIO address of the disk controller"
  default 0xa0000300

config DISK_IMG_PATH
  string "The path of disk image"
  default ""
endif # HAS_DISK

menuconfig HAS_SDCARD
  bool "Enable sdcard"
  default n

if HAS_SDCARD
config SDCARD_CTL_MMIO
  hex "MMIO address of the sdcard controller"
  default 0xa3000000

config SDCARD_IMG_PATH
  string "The path of sdcard image"
  default ""
endif # HAS_SDCARD
endif

endif # DEVICE
```

## memu/csrc/memory/Kconfig
```kconfig
menu "Memory"

choice
  depends on SOC
  prompt "SoC boot source"
  default SOC_BOOT_FLASH
config SOC_BOOT_MROM
  bool "MROM"
config SOC_BOOT_FLASH
  bool "FLASH"
endchoice


menu "MROM"
depends on SOC_BOOT_MROM
config SOC_MROM_BASE
  depends on SOC
  hex "MROM base address"
  default 0x20000000
config SOC_MROM_SIZE
  depends on SOC
  hex "MROM size"
  default 0x1000
endmenu


menu "FLASH"
depends on SOC_BOOT_FLASH
config SOC_FLASH_BASE
  depends on SOC
  hex "Flash XIP base address"
  default 0x30000000
config SOC_FLASH_SIZE
  depends on SOC
  hex "Flash size"
  default 0x1000000
config SOC_FAST_FLASH
  depends on NPC
  bool "Use fast Flash XIP model"
  default y
  help
    Read XIP data directly through DPI instead of issuing a complete SPI
    transaction for every instruction fetch. Disable this option when testing
    the SPI controller, Flash pins or precise XIP timing.
endmenu


menu "SRAM"
config SOC_SRAM_BASE
  depends on SOC
  hex "SRAM base address"
  default 0x0f000000
config SOC_SRAM_SIZE
  depends on SOC
  hex "SRAM size"
  default 0x2000
endmenu


menuconfig HAS_PSRAM
  depends on SOC
  bool "Enable PSRAM"
  default y
if HAS_PSRAM
config SOC_PSRAM_BASE
  hex "PSRAM base address"
  default 0x80000000
config SOC_PSRAM_SIZE
  hex "PSRAM size"
  default 0x400000
config SOC_FAST_PSRAM
  depends on NPC
  bool "Use fast functional PSRAM model"
  default n
  help
    Bypass QPI transfers during normal software simulation while preserving
    the APB interface and memory contents. Disable this option when testing
    the PSRAM controller, QPI initialization or particles.
config SOC_PSRAM_PRELOAD
  depends on SOC_FAST_PSRAM && SOC_BOOT_FLASH && !DIFFTEST
  bool "Preload PSRAM program from ELF"
  default n
  help
    Load ELF segments directly into PSRAM and replace the flash boot entry
    with a short trampoline. This skips the slow CPU-driven copy during
    software simulation. Disable it when testing FSBL/SSBL behavior.
endif


menuconfig HAS_SDRAM
  depends on SOC
  bool "Enable SDRAM"
  default y
if HAS_SDRAM
config SOC_SDRAM_BASE
  hex "SDRAM base address"
  default 0xa0000000
config SOC_SDRAM_SIZE
  hex "SDRAM size"
  default 0x2000000
config SOC_FAST_SDRAM
  depends on NPC
  bool "Use fast functional SDRAM model"
  default n
  help
    Bypass pin-level SDRAM commands and timing during normal software
    simulation while preserving the AXI interface and memory contents.
    Disable this option when testing the SDRAM controller or particles.
config SOC_FAST_BOOT
  depends on SOC_FAST_SDRAM && SOC_BOOT_FLASH && !DIFFTEST
  bool "Preload SDRAM program from ELF"
  default n
  help
    Load ELF segments directly into SDRAM and replace the flash boot entry
    with a short trampoline. This skips the slow CPU-driven copy during
    software simulation. Disable it when testing FSBL/SSBL behavior.
endif


config MBASE_NOSOC
  hex
  depends on !SOC
  default 0x80000000
config MBASE_SOC
  hex
  default SOC_MROM_BASE if SOC_BOOT_MROM
  default SOC_FLASH_BASE if SOC_BOOT_FLASH
config MBASE
  hex
  default MBASE_SOC if SOC
  default MBASE_NOSOC


config MSIZE_NOSOC
  hex
  depends on !SOC
  default 0x8000000
config MSIZE_SOC
  hex
  default SOC_MROM_SIZE if SOC_BOOT_MROM
  default SOC_FLASH_SIZE if SOC_BOOT_FLASH
config MSIZE
  hex
  default MSIZE_SOC if SOC
  default MSIZE_NOSOC


config PC_RESET_OFFSET
  hex "Offset of reset vector from the base of memory"
  default 0x100000 if ISA_x86
  default 0

choice
  prompt "Physical memory definition"
  default PMEM_GARRAY
config PMEM_MALLOC
  bool "Using malloc()"
config PMEM_GARRAY
  depends on !TARGET_AM
  bool "Using global array"
endchoice

config MEM_RANDOM
  depends on !DIFFTEST && !TARGET_AM
  bool "Initialize the memory with random values"
  default y
  help
    This may help to find undefined behaviors.

endmenu #MEMORY
```
