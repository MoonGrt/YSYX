## memu/configs/tmp_defconfig
```kconfig
CONFIG_NPC=y
CONFIG_MTRACE=y
CONFIG_DIFFTEST=y
# CONFIG_WATCHPOINT is not set
CONFIG_DEVICE=y
```

## nemu/configs/tmp_defconfig
```kconfig
# CONFIG_TRACE is not set
CONFIG_DIFFTEST=y
# CONFIG_WATCHPOINT is not set
CONFIG_DEVICE=y
```

## nemu2npc/configs/riscv32-am_defconfig
```kconfig
CONFIG_TARGET_AM=y
# CONFIG_TRACE is not set
# CONFIG_WATCHPOINT is not set
CONFIG_MSIZE=0x2000000
CONFIG_DEVICE=y
```
